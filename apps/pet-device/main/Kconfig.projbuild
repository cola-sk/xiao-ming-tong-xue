## apps/pet-device/main/Kconfig.projbuild
```kconfig
menu "AI Chat Pet (小铭同学) Configuration"

    config PET_WIFI_SSID
        string "Wi-Fi SSID"
        default "myssid"
        help
            SSID (network name) for the ESP32-S3 device to connect to.

    config PET_WIFI_PASSWORD
        string "Wi-Fi Password"
        default "mypassword"
        help
            Wi-Fi password (WPA or WPA2).

    config PET_SERVER_URL
        string "Backend Server Base URL"
        default "https://xiao-ming-tong-xue.vercel.app"
        help
            Base URL of the Next.js backend deployed on Vercel (without trailing slash).

    config PET_DEVICE_TOKEN
        string "Device API token (same as PET_DEVICE_TOKEN on server)"
        default ""
        help
            Provision a unique random token of at least 32 characters via sdkconfig.
            Treat firmware and sdkconfig as secrets. Only sent to the HTTPS server URL.

    config PET_HEARTBEAT_INTERVAL_SEC
        int "Device Heartbeat Interval (seconds)"
        range 5 120
        default 30
        help
            Interval in seconds between HTTPS heartbeat sync requests to /api/v1/device/sync. (Can be 30-60s when MQTT is enabled).

    menu "EMQX Cloud Serverless MQTT (Real-time Wakeup < 0.3s)"
        config PET_MQTT_ENABLE
            bool "Enable EMQX Serverless MQTT over TLS (Port 8883)"
            default y
            help
                Connect to EMQX Cloud Serverless over TLS 8883 for instant push wakeup.

        config PET_MQTT_BROKER_URI
            string "EMQX Broker TLS URI"
            depends on PET_MQTT_ENABLE
            default "mqtts://your-deployment.emqxsl.com:8883"
            help
                EMQX Cloud Serverless TLS endpoint URI (mqtts://<host>:8883).

        config PET_MQTT_USERNAME
            string "EMQX Client Username"
            depends on PET_MQTT_ENABLE
            default "esp32_pet"
            help
                Client authentication username created in EMQX Cloud Console -> Authentication.

        config PET_MQTT_PASSWORD
            string "EMQX Client Password"
            depends on PET_MQTT_ENABLE
            default "your_password"
            help
                Client authentication password created in EMQX Cloud Console -> Authentication.
    endmenu

    menu "Local WeChat Voice Cache Policy"
        config PET_WECHAT_MAX_BYTES_KB
            int "Max WeChat Cache Size (KB)"
            range 512 131072
            default 4096
            help
                Total storage quota in KB for local WeChat voice cache (4096 KB = 4 MB for Flash, increase e.g. 131072 KB = 128 MB when TF card is inserted).

        config PET_WECHAT_MAX_COUNT
            int "Max WeChat Cached Messages"
            range 5 500
            default 20
            help
                Maximum number of WeChat voice files kept locally before oldest messages are evicted (20 for Flash, up to 200+ for TF card).

        config PET_WECHAT_MAX_AGE_DAYS
            int "Max WeChat Retention Days"
            range 1 90
            default 7
            help
                Maximum retention days for cached WeChat voice files before auto-cleanup.
    endmenu

endmenu
```

## apps/pet-device/sdkconfig.defaults
```kconfig
CONFIG_ESPTOOLPY_FLASHSIZE_16MB=y
CONFIG_PARTITION_TABLE_CUSTOM=y
CONFIG_PARTITION_TABLE_CUSTOM_FILENAME="partitions.csv"
CONFIG_SPIRAM=y
CONFIG_SPIRAM_MODE_OCT=y
CONFIG_SPIRAM_SPEED_80M=y
CONFIG_SPIRAM_MALLOC_ALWAYSINTERNAL=1024
CONFIG_SPIRAM_MALLOC_RESERVE_INTERNAL=98304
CONFIG_FREERTOS_HZ=1000
CONFIG_LWIP_DNS_MAX_HOST_IP=4
CONFIG_LWIP_TCP_SND_BUF_DEFAULT=16384
CONFIG_LV_FONT_MONTSERRAT_24=y
CONFIG_LV_USE_CLIB_MALLOC=y
CONFIG_LV_OS_FREERTOS=y

CONFIG_SPIFFS_OBJ_NAME_LEN=96
CONFIG_SPIRAM_ALLOW_STACK_EXTERNAL_MEMORY=y

CONFIG_MBEDTLS_DEFAULT_MEM_ALLOC=y
CONFIG_FREERTOS_WATCHPOINT_END_OF_STACK=y
```
